## Smartbutton-esp32-c5/sdkconfig.defaults
```kconfig
CONFIG_IDF_TARGET="esp32c5"
CONFIG_FREERTOS_HZ=1000
CONFIG_ESPTOOLPY_FLASHSIZE_4MB=y
CONFIG_ESPTOOLPY_FLASHSIZE="4MB"
CONFIG_PARTITION_TABLE_CUSTOM=y
CONFIG_HTTPD_MAX_REQ_HDR_LEN=1024
CONFIG_HTTPD_MAX_URI_LEN=1024
CONFIG_MBEDTLS_CMAC_C=y
CONFIG_ESP_HTTPS_SERVER_ENABLE=y
```

## WiFi-Motion-RSSI-C3-Supermini/main/Kconfig.projbuild
```kconfig
menu "WiFi motion detector"

config MOTION_WIFI_SSID
    string "WiFi SSID"
    default ""
    help
        Bootstrap SSID. Runtime provisioning is planned for phase 2.

config MOTION_WIFI_PASSWORD
    string "WiFi password"
    default ""

config MOTION_SAMPLE_INTERVAL_MS
    int "RSSI sampling interval (ms)"
    range 50 5000
    default 100

config MOTION_WINDOW_SIZE
    int "Activity window (samples)"
    range 4 128
    default 20

config MOTION_CALIBRATION_SAMPLES
    int "Calibration scores"
    range 10 10000
    default 120

config MOTION_SIGMA_MULTIPLIER_X100
    int "Threshold sigma multiplier x100"
    range 100 1200
    default 600

config MOTION_MIN_THRESHOLD_X100
    int "Minimum activity threshold x100"
    range 1 1000
    default 30

config MOTION_TRIGGER_CONSECUTIVE
    int "Consecutive scores to trigger"
    range 1 100
    default 3

config MOTION_CLEAR_CONSECUTIVE
    int "Consecutive scores to clear"
    range 1 100
    default 8

config MOTION_LED_GPIO
    int "Status LED GPIO (-1 disables)"
    range -1 21
    default 8

config MOTION_LED_ACTIVE_LOW
    bool "Status LED is active-low"
    default y

choice MOTION_OUTPUT_FORMAT
    prompt "Serial output format"
    default MOTION_OUTPUT_CSV

config MOTION_OUTPUT_CSV
    bool "CSV"

config MOTION_OUTPUT_JSON
    bool "JSON lines"

endchoice

endmenu
```

## WiFi-Motion-RSSI-C3-Supermini/sdkconfig.defaults
```kconfig
CONFIG_IDF_TARGET="esp32c3"
CONFIG_FREERTOS_HZ=1000
CONFIG_ESPTOOLPY_FLASHSIZE_4MB=y
CONFIG_ESPTOOLPY_FLASHSIZE="4MB"
CONFIG_PARTITION_TABLE_CUSTOM=y
CONFIG_ESP_CONSOLE_USB_SERIAL_JTAG=y
CONFIG_ESP_CONSOLE_UART_DEFAULT=n
CONFIG_COMPILER_OPTIMIZATION_PERF=y
CONFIG_LOG_DEFAULT_LEVEL_INFO=y
```

## WiFi-Motion-RSSI-ESP32-C3-OLED-0.42/main/Kconfig.projbuild
```kconfig
menu "WiFi motion detector"

config MOTION_WIFI_SSID
    string "WiFi SSID"
    default ""
    help
        Bootstrap SSID used when no runtime configuration exists.

config MOTION_WIFI_PASSWORD
    string "WiFi password"
    default ""

config MOTION_PORTAL_AP_PASSWORD
    string "Recovery access point password"
    default "motion-setup"
    help
        Password for the recovery AP. Use at least eight characters. If shorter,
        the recovery AP is intentionally opened and a warning is logged.

config MOTION_SAMPLE_INTERVAL_MS
    int "RSSI sampling interval (ms)"
    range 50 5000
    default 100

choice MOTION_SENSITIVITY_PROFILE
    prompt "Sensitivity profile preset"
    default MOTION_PROFILE_BALANCED

config MOTION_PROFILE_LOW
    bool "Low sensitivity"

config MOTION_PROFILE_BALANCED
    bool "Balanced"

config MOTION_PROFILE_HIGH
    bool "High sensitivity"

endchoice

choice MOTION_FEATURE_ALGORITHM
    prompt "RSSI feature algorithm"
    default MOTION_FEATURE_MEAN_ABSOLUTE_DIFFERENCE

config MOTION_FEATURE_MEAN_ABSOLUTE_DIFFERENCE
    bool "Mean absolute difference"

config MOTION_FEATURE_STANDARD_DEVIATION
    bool "Standard deviation"

config MOTION_FEATURE_SAMPLE_VARIANCE
    bool "Sample variance"

config MOTION_FEATURE_RANGE
    bool "Maximum-minimum range"

config MOTION_FEATURE_MEDIAN_ABSOLUTE_DEVIATION
    bool "Median absolute deviation"

endchoice

choice MOTION_BASELINE_MODE
    prompt "Adaptive baseline model"
    default MOTION_BASELINE_MEAN_STDDEV

config MOTION_BASELINE_MEAN_STDDEV
    bool "Mean and standard deviation"

config MOTION_BASELINE_MEDIAN_MAD
    bool "Median and MAD (robust)"

endchoice

config MOTION_WINDOW_SIZE
    int "Activity window (samples)"
    range 4 128
    default 20

config MOTION_CALIBRATION_SAMPLES
    int "Calibration scores"
    range 10 512
    default 120

config MOTION_SIGMA_MULTIPLIER_X100
    int "Threshold sigma multiplier x100"
    range 100 1200
    default 800 if MOTION_PROFILE_LOW
    default 400 if MOTION_PROFILE_HIGH
    default 600

config MOTION_MIN_THRESHOLD_X100
    int "Minimum activity threshold x100"
    range 1 1000
    default 30

config MOTION_TRIGGER_CONSECUTIVE
    int "Consecutive scores to trigger"
    range 1 100
    default 4 if MOTION_PROFILE_LOW
    default 2 if MOTION_PROFILE_HIGH
    default 3

config MOTION_CLEAR_CONSECUTIVE
    int "Consecutive scores to clear"
    range 1 100
    default 10 if MOTION_PROFILE_LOW
    default 5 if MOTION_PROFILE_HIGH
    default 8

config MOTION_RELEASE_THRESHOLD_RATIO_X100
    int "Release threshold ratio x100"
    range 1 99
    default 70 if MOTION_PROFILE_HIGH
    default 75

config MOTION_BASELINE_UPDATE_ALPHA_X10000
    int "Idle baseline update alpha x10000"
    range 1 10000
    default 200 if MOTION_PROFILE_HIGH
    default 100

config MOTION_LED_GPIO
    int "Status LED GPIO (-1 disables)"
    range -1 21
    default 8

config MOTION_LED_ACTIVE_LOW
    bool "Status LED is active-low"
    default y

config MOTION_MARKER_GPIO
    int "Physical experiment marker GPIO (-1 disables)"
    range -1 21
    default 9
    help
        GPIO connected to the active-low BOOT marker button. GPIO9 is a
        strapping pin on ESP32-C3: press it only after normal boot and never
        while resetting or powering the board.

config MOTION_MARKER_DEBOUNCE_MS
    int "Physical marker debounce interval (ms)"
    range 50 2000
    default 250

config MOTION_CSI_ENABLED
    bool "Enable CSI capture from the connected router"
    depends on SOC_WIFI_CSI_SUPPORT
    select ESP_WIFI_CSI_ENABLED
    default y
    help
        Captures LLTF CSI frames whose source MAC matches the connected access
        point. Feature extraction runs outside the Wi-Fi callback.

config MOTION_CSI_TRAFFIC_ENABLED
    bool "Generate controlled ICMP traffic for CSI"
    depends on MOTION_CSI_ENABLED
    default y

config MOTION_CSI_TRAFFIC_INTERVAL_MS
    int "Controlled CSI traffic interval (ms)"
    depends on MOTION_CSI_TRAFFIC_ENABLED
    range 20 1000
    default 50

config MOTION_CSI_TRAFFIC_TIMEOUT_MS
    int "Controlled CSI traffic timeout (ms)"
    depends on MOTION_CSI_TRAFFIC_ENABLED
    range 50 2000
    default 200

config MOTION_CSI_TRAFFIC_PAYLOAD_BYTES
    int "Controlled CSI traffic payload size (bytes)"
    depends on MOTION_CSI_TRAFFIC_ENABLED
    range 1 256
    default 1

choice MOTION_OUTPUT_FORMAT
    prompt "Serial output format"
    default MOTION_OUTPUT_CSV

config MOTION_OUTPUT_CSV
    bool "CSV"

config MOTION_OUTPUT_JSON
    bool "JSON lines"

endchoice

endmenu
```

## WiFi-Repeater-WPA2-Enterprise/sdkconfig.defaults
```kconfig
# Target
CONFIG_IDF_TARGET="esp32c3"

# Partition table
CONFIG_PARTITION_TABLE_CUSTOM=y
CONFIG_PARTITION_TABLE_CUSTOM_FILENAME="partitions.csv"

# WiFi
CONFIG_ESP_WIFI_SOFTAP_SUPPORT=y
CONFIG_ESP_WIFI_ENTERPRISE_SUPPORT=y

# lwIP - NAPT & IP Forward
CONFIG_LWIP_IP_FORWARD=y
CONFIG_LWIP_IPV4_NAPT=y
CONFIG_LWIP_MAX_SOCKETS=16
CONFIG_LWIP_TCP_SND_BUF_DEFAULT=5744
CONFIG_LWIP_TCP_WND_DEFAULT=5744
CONFIG_LWIP_TCP_RECVMBOX_SIZE=16
CONFIG_LWIP_UDP_RECVMBOX_SIZE=16
CONFIG_LWIP_TCPIP_RECVMBOX_SIZE=32

# DHCP
CONFIG_LWIP_DHCPS=y
CONFIG_LWIP_DHCP_RESTORE_LAST_IP=y

# HTTP Server
CONFIG_HTTPD_MAX_REQ_HDR_LEN=1024
CONFIG_HTTPD_MAX_URI_LEN=512

# Log level
CONFIG_LOG_DEFAULT_LEVEL_INFO=y

# Task watchdog
CONFIG_ESP_TASK_WDT_TIMEOUT_S=10
```
